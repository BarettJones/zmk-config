## boards/shields/codex6/Kconfig.defconfig
```kconfig
if SHIELD_CODEX6

# Name must be less than 16 characters long!
config ZMK_KEYBOARD_NAME
    default "Codex6"

endif
```

## boards/shields/codex6/Kconfig.shield
```kconfig
# No whitespace after the comma or in your keyboard name!
config SHIELD_CODEX6
    def_bool $(shields_list_contains,codex6)
```
